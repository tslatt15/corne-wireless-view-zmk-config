## config/west.yml
```yaml
manifest:
  remotes:
    - name: zmkfirmware
      url: https://github.com
    - name: dsifry
      url: https://github.com
  projects:
    - name: zmk
      remote: zmkfirmware
      revision: v0.3 # Crucial: Keeps your firmware on the stable v0.3 track
      import: app/west.yml
    - name: nice-view-mod
      remote: dsifry
      revision: main
  self:
    path: config
```
